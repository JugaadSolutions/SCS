#include "mmd.h"
#include "string.h"


rom const UINT8 FontTable5x7[][8]= {			// ASCII	DEC
0x00,0x00,0x00,0x00,0x00,0x00,0x00,(0x00),		// space  	32
0x20,0x20,0x20,0x20,0x00,0x00,0x20,(0x00),		// !		33
0x50,0x50,0x50,0x00,0x00,0x00,0x00,(0x00),		// "		34
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0x00,0x40,0x40,0x40,0x40,0x78,0x00,0x00,		//			SYM_LOADING



};



typedef struct _BITPACK_TABLE
{
	UINT8 mask;
	UINT8 shiftCount;
	
}BITPACK_TABLE;

rom BITPACK_TABLE rightBitPackTable[COLUMNS_PER_SYMBOL+1]={
{0,0},{0x80,5},{0xC0,4},{0xE0,3},{0xF0,2},{0xF8,1}
};


rom BITPACK_TABLE leftBitPackTable[COLUMNS_PER_SYMBOL+1]={
{0,0},{0x08,4},{0x18,3},{0x38,2},{0x78,1},{0xF8,0}
};



typedef struct _MMD_Segment
{
	UINT8 id;
	UINT8 startAddress;
	UINT8 length;
	far UINT8 *symbolBuffer;
	UINT8 symbolCount;
	SCROLL_SPEED scrollSpeed;
	UINT8 speedCount;
	UINT8 curSymbolIndex;
	UINT8 switchBuffer;
	UINT8 shiftCount;
	UINT8 curShiftBuffer;
	UINT8 curDispBuffer;
	far UINT8 DispBuffer[2][ROWS_PER_SYMBOL][MMD_MAX_CHARS];
	far UINT8 DispDataBuffer[ROWS_PER_SYMBOL][MMD_MAX_CHARS];


}MMD_Segment;



void WriteDataToDisplay(UINT8 digit, UINT8 data);
void makeBitMap(UINT8 id , UINT8 row );


#pragma idata mmd_data
MMD_Segment mmdSegment[MMD_MAX_SEGMENTS]= {0};
#pragma udata


/*
*------------------------------------------------------------------------------
* static BOOL getBit(UINT8 data , UINT8 bitNo)
*
* Summary	: get a bit at specified position from a byte
*
* Input		: UINT8 data  - byte to get the bit 
*		      UINT8 bitNo - bit position
*
* Output	: None
*
*------------------------------------------------------------------------------
*/
static BOOL getBit(UINT8 data , UINT8 bitNo)
{
	BOOL bitValue = (data & ((UINT8) 1 << bitNo)) ? 1 : 0;
	return bitValue;
}

/*
*------------------------------------------------------------------------------
* static void setBit(UINT8 *data , UINT8 bitNo)
*
* Summary	: set a bit at specified position in  a byte
*
* Input		: UINT8 *data  - pointer to a byte to set the bit 
*		      UINT8 bitNo - bit position
*
* Output	: None
*
*------------------------------------------------------------------------------
*/
static void setBit(UINT8 *data , UINT8 bitNo)
{
	*data  |= ((UINT8)1 << bitNo);
	
}

/*
*------------------------------------------------------------------------------
* static void clearBit(UINT8 *data , UINT8 bitNo)
*
* Summary	: clear a bit at specified position in  a byte
*
* Input		: UINT8 *data  - pointer to a byte to clear the bit 
*		      UINT8 bitNo - bit position
*
* Output	: None
*
*------------------------------------------------------------------------------
*/
static void clearBit(UINT8 *data , UINT8 bitNo)
{
	*data &= ~ (((UINT8) 1 << bitNo));
}




void MMD_init()
{
	UINT8 i,j,k;
	for( i = 0; i < MMD_MAX_SEGMENTS ; i++)
	{
		mmdSegment[i].id = i+1;
		mmdSegment[i].startAddress = 0;
		mmdSegment[i].symbolBuffer = 0;
		mmdSegment[i].symbolCount = 0;		
		mmdSegment[i].scrollSpeed = SCROLL_SPEED_NONE;
		mmdSegment[i].switchBuffer = 0;
		mmdSegment[i].shiftCount = 0;
		mmdSegment[i].speedCount = 0;
		mmdSegment[i].curShiftBuffer = 0;
		mmdSegment[i].curDispBuffer = 0;
		mmdSegment[i].curSymbolIndex = 0;
		mmdSegment[i].length = 0;
		
		j= ROWS_PER_SYMBOL*MMD_MAX_CHARS;
		memset((void*)mmdSegment[i].DispDataBuffer,0,j);
		memset((void*)mmdSegment[i].DispBuffer[0],0,j);
		memset((void*)mmdSegment[i].DispBuffer[1],0,j);
	}

}


BOOL MMD_configSegment( UINT8 id,  MMD_Config *config )
{

	UINT8 i,j,k;
	INT8 curSymbolIndex,curSymbol;
	MMD_Config *tmp;		//temp pointer to help in copying config info

	if( id >= MMD_MAX_SEGMENTS					//check for allowable data
		|| config->startAddress >= MMD_MAX_ADDRESS
		|| config->symbolBuffer == 0)

	{
		return FALSE;
	}

	tmp = (MMD_Config*) &mmdSegment[id].startAddress;	//cast to config structure
	*tmp = *config;									//copy 
	
	mmdSegment[id].speedCount = mmdSegment[id].scrollSpeed;
	i = ROWS_PER_SYMBOL * MMD_MAX_CHARS;
	memset((UINT8*)mmdSegment[id].DispDataBuffer,0,i);
	memset((UINT8*)mmdSegment[id].DispBuffer[0],0,i);
	memset((UINT8*)mmdSegment[id].DispBuffer[1],0,i);

	if( mmdSegment[id].scrollSpeed == SCROLL_SPEED_NONE)
	{
		mmdSegment[id].curSymbolIndex = 0;
		for( i = 0; i < mmdSegment[id].length ; i++)
		{
			
			curSymbol = mmdSegment[id].symbolBuffer[mmdSegment[id].curSymbolIndex++]-32;
			if( (curSymbol < 0) || (curSymbol > 0x63 ))
				curSymbol = 0;
			if(mmdSegment[id].curSymbolIndex >= mmdSegment[id].symbolCount)
				mmdSegment[id].curSymbolIndex = 0;

			for( j = 0; j < ROWS_PER_SYMBOL ; j++)
			{	


				mmdSegment[id].DispDataBuffer[j][i] = (FontTable5x7[curSymbol ][j]);
				mmdSegment[id].DispBuffer[0][j][i] = mmdSegment[id].DispDataBuffer[j][i];
				mmdSegment[id].DispBuffer[1][j][i] = mmdSegment[id].DispDataBuffer[j][i];
			}
			
		}
	}
	else
	{
		mmdSegment[id].curSymbolIndex = 0;
		for( i = 0; i < mmdSegment[id].length ; i++)
		{
			curSymbol = mmdSegment[id].symbolBuffer[mmdSegment[id].curSymbolIndex++]-32;
	        if( (curSymbol < 0) || (curSymbol > 0x63 ))
				curSymbol = 0;
			if(mmdSegment[id].curSymbolIndex >= mmdSegment[id].symbolCount)
				mmdSegment[id].curSymbolIndex = 0;
			for( j = 0; j < ROWS_PER_SYMBOL ; j++)
			{	

				mmdSegment[id].DispDataBuffer[j][i] = (FontTable5x7[curSymbol ][j]) ;
				mmdSegment[id].DispBuffer[0][j][i] = mmdSegment[id].DispDataBuffer[j][i];
				mmdSegment[id].DispBuffer[1][j][i] = mmdSegment[id].DispDataBuffer[j][i];
			}
			
		}
	}
	mmdSegment[id].curSymbolIndex = 0;
	return TRUE;
}

void MMD_setScrollSpeed( UINT8 id , SCROLL_SPEED speed )
{
	
	mmdSegment[id].scrollSpeed = speed;
	mmdSegment[id].speedCount = speed;

}	


void MMD_changeSymbol( UINT8 segmentID , UINT8 symbolID)
{
	UINT8 j;
	UINT8 curSymbol ;

	curSymbol = mmdSegment[segmentID].symbolBuffer[symbolID]-32;

	for( j = 0; j < ROWS_PER_SYMBOL ; j++)
	{	

		mmdSegment[segmentID].DispDataBuffer[j][symbolID] = (FontTable5x7[curSymbol ][j]) ;
		mmdSegment[segmentID].DispBuffer[0][j][symbolID] = mmdSegment[0].DispDataBuffer[j][symbolID];
		mmdSegment[segmentID].DispBuffer[1][j][symbolID] = mmdSegment[0].DispDataBuffer[j][symbolID];
	}
}

void MMD_clearSegment(UINT8 id)
{
	UINT8 size;

		mmdSegment[id].startAddress = 0;
		mmdSegment[id].symbolBuffer = 0;
		mmdSegment[id].symbolCount = 0;		
		mmdSegment[id].scrollSpeed = SCROLL_SPEED_NONE;
		mmdSegment[id].switchBuffer = 0;
		mmdSegment[id].shiftCount = 0;
		mmdSegment[id].speedCount = 0;
		mmdSegment[id].curShiftBuffer = 0;
		mmdSegment[id].curDispBuffer = 0;
		mmdSegment[id].curSymbolIndex = 0;
		mmdSegment[id].length = 0;

		size = ROWS_PER_SYMBOL*MMD_MAX_CHARS;
		
		memset((UINT8*)mmdSegment[id].DispDataBuffer,0,size);
		memset((UINT8*)mmdSegment[id].DispBuffer[0],0,size);
		memset((UINT8*)mmdSegment[id].DispBuffer[1],0,size);

	
}
void MMD_task(void)
{
	UINT8 i , j , k;
	UINT8 curSymbol,curRowData;

	for( i = 0; i < MMD_MAX_SEGMENTS ; i++)
	{
		if( mmdSegment[i].scrollSpeed != SCROLL_SPEED_NONE)
		{
			--mmdSegment[i].speedCount;
			if( mmdSegment[i].speedCount > 0)	
				continue;
		}
		mmdSegment[i].speedCount = mmdSegment[i].scrollSpeed;

		DISABLE_TMR1_INTERRUPT();
		if( mmdSegment[i].switchBuffer == 0 )
		{
			mmdSegment[i].curShiftBuffer = ( mmdSegment[i].curDispBuffer == 0 )? 1 : 0;
				
		}
		if(mmdSegment[i].switchBuffer == 1 )
		{
			ENABLE_TMR1_INTERRUPT();
		 	continue;
		}
	
		ENABLE_TMR1_INTERRUPT();
	

		if( mmdSegment[i].scrollSpeed == SCROLL_SPEED_NONE)
		{/*
			for( j = 0; j < ROWS_PER_SYMBOL; j++)
			{
				for( k = 0; k < mmdSegment[i].length; k++)
				{
					mmdSegment[i].DispBuffer[mmdSegment[i].curShiftBuffer][j][k] = mmdSegment[i].DispDataBuffer[j][k];
				}
			}
		*/
		}
		else
		{
			
			for( j = 0; j < ROWS_PER_SYMBOL; j++)
			{
				for( k = 1; k < mmdSegment[i].length; k++)
				{
					mmdSegment[i].DispDataBuffer[j][k-1] <<= 1;
					
					if( getBit(mmdSegment[i].DispDataBuffer[j][k],7) == 1 )
						setBit(&mmdSegment[i].DispDataBuffer[j][k-1] , 8-COLUMNS_PER_CHARACTER);
					else
						clearBit(&mmdSegment[i].DispDataBuffer[j][k-1],8-COLUMNS_PER_CHARACTER);
					mmdSegment[i].DispBuffer[mmdSegment[i].curShiftBuffer][j][k-1] = mmdSegment[i].DispDataBuffer[j][k-1];
				}
					
				mmdSegment[i].DispDataBuffer[j][k-1] <<= 1;
				curSymbol = mmdSegment[i].symbolBuffer[mmdSegment[i].curSymbolIndex]-32;
				 if( (curSymbol < 0) || (curSymbol > 0x63 ))
					curSymbol = 0;	
				curRowData	 = FontTable5x7[curSymbol][j];
				if( getBit(curRowData,7-mmdSegment[i].shiftCount) == 1 )
				{
					setBit(&(mmdSegment[i].DispDataBuffer[j][k-1]) , 8-COLUMNS_PER_CHARACTER);
				}
				else
				{
					clearBit(&(mmdSegment[i].DispDataBuffer[j][k-1]),8-COLUMNS_PER_CHARACTER);
				}

				mmdSegment[i].DispBuffer[mmdSegment[i].curShiftBuffer][j][k-1] = mmdSegment[i].DispDataBuffer[j][k-1];
			}
			++mmdSegment[i].shiftCount;

			if( mmdSegment[i].shiftCount >= COLUMNS_PER_CHARACTER)
			{
				mmdSegment[i].curSymbolIndex++;
				if( mmdSegment[i].curSymbolIndex >= mmdSegment[i].symbolCount)
				{
					mmdSegment[i].curSymbolIndex = 0;
				}
				
				mmdSegment[i].shiftCount = 0;
				
			}
			
		}

		DISABLE_TMR1_INTERRUPT();
		mmdSegment[i].switchBuffer = 1;
		ENABLE_TMR1_INTERRUPT();
	}

}				

UINT8 iSRState = 0;
void MMD_refreshDisplay(void)
{
	UINT8 dataByte,addr;
	UINT8 i,j;

	//MMD_CONTROL = 0;	//disable the display
	ROW_SEL_A = 0;
	ROW_SEL_B = 0;
	ROW_SEL_C = 0;
	ROW_SEL_D = 0;
	ROW_SEL_E = 0;
	ROW_SEL_F = 0;
	ROW_SEL_G = 0;
	ROW_SEL_H = 0;
	
	for( i = 0 ; i < MMD_MAX_SEGMENTS ; i++)
	{
		
		for( j = 0 ; j < mmdSegment[i].length ; j++)
		{
			dataByte = mmdSegment[i].DispBuffer[mmdSegment[i].curDispBuffer][iSRState][j];

			addr = mmdSegment[i].startAddress + j;					//set the address
/*
			if( addr >=64 )	//workaround for PCB flaw 
			{				//- pins 39 & 40 are interchanged in 10 pin connector 
				addr +=128;
			}
*/
			//DISPLAY_CONTROL = DISPLAY_DISABLE;

			DIGIT_PORT = addr;
			DATA_PORT = ~dataByte;
			DISPLAY_CONTROL = DISPLAY_ENABLE;	//enable the display					
			Delay10us(1);
			DISPLAY_CONTROL = DISPLAY_DISABLE;	//disable the display					


		}
	}

	switch( iSRState )
	{
		case 0:
			ROW_SEL_A = 1;
			ROW_SEL_B = 0;
			ROW_SEL_C = 0;
			ROW_SEL_D = 0;
			ROW_SEL_E = 0;
			ROW_SEL_F = 0;
			ROW_SEL_G = 0;
			ROW_SEL_H = 0;
			break;

		case 1:
			ROW_SEL_A = 0;
			ROW_SEL_B = 1;
			ROW_SEL_C = 0;
			ROW_SEL_D = 0;
			ROW_SEL_E = 0;
			ROW_SEL_F = 0;
			ROW_SEL_G = 0;	
			ROW_SEL_H = 0;
			break;

		case 2:
			ROW_SEL_A = 0;
			ROW_SEL_B = 0;
			ROW_SEL_C = 1;
			ROW_SEL_D = 0;
			ROW_SEL_E = 0;
			ROW_SEL_F = 0;
			ROW_SEL_G = 0;
			ROW_SEL_H = 0;	
			break;

		case 3:
			ROW_SEL_A = 0;
			ROW_SEL_B = 0;
			ROW_SEL_C = 0;
			ROW_SEL_D = 1;
			ROW_SEL_E = 0;
			ROW_SEL_F = 0;
			ROW_SEL_G = 0;
			ROW_SEL_H = 0;
			break;

		case 4:
			ROW_SEL_A = 0;
			ROW_SEL_B = 0;
			ROW_SEL_C = 0;
			ROW_SEL_D = 0;
			ROW_SEL_E = 1;
			ROW_SEL_F = 0;
			ROW_SEL_G = 0;
			ROW_SEL_H = 0;
			break;

		case 5:
			ROW_SEL_A = 0;
			ROW_SEL_B = 0;
			ROW_SEL_C = 0;
			ROW_SEL_D = 0;
			ROW_SEL_E = 0;
			ROW_SEL_F = 1;
			ROW_SEL_G = 0;
			ROW_SEL_H = 0;
			break;

		case 6:
			ROW_SEL_A = 0;
			ROW_SEL_B = 0;
			ROW_SEL_C = 0;
			ROW_SEL_D = 0;
			ROW_SEL_E = 0;
			ROW_SEL_F = 0;
			ROW_SEL_G = 1;
			ROW_SEL_H = 0;
			break;

		case 7:
			ROW_SEL_A = 0;
			ROW_SEL_B = 0;
			ROW_SEL_C = 0;
			ROW_SEL_D = 0;
			ROW_SEL_E = 0;
			ROW_SEL_F = 0;
			ROW_SEL_G = 0;
			ROW_SEL_H = 1;
			break;

 		default:
			break;
	}

//	MMD_CONTROL = 1;
	iSRState++;
	if( iSRState > ROWS_PER_SYMBOL )
	{
		iSRState = 0;

#ifndef __MMD_STATIC__

		for( i = 0 ; i < MMD_MAX_SEGMENTS ; i++)
		{
			if( mmdSegment[i].switchBuffer == 1 )
			{
				mmdSegment[i].curDispBuffer = (mmdSegment[i].curDispBuffer == 0) ?1 : 0 ;
				mmdSegment[i].switchBuffer = 0;
			}
		}
#endif
	}
}



	



/*
*------------------------------------------------------------------------------
* void WriteDataToDisplay(UINT8 digit, UINT8 data)
*
* Summary	: Write one byte data on the bus
*
* Input		: UINT8 digit - digit number to write the data
*			  UINT8 dataByte - data byte for the digit
*
* Output	: None
*------------------------------------------------------------------------------
*/
void WriteDataToDisplay(UINT8 digit, UINT8 data)
{
	if( digit >=64 )
	{
		digit+=128;
	}
	DISPLAY_CONTROL = DISPLAY_DISABLE;	//disable the display
	DIGIT_PORT = digit;					//set the address
	DATA_PORT = data;					// write data
	DISPLAY_CONTROL = DISPLAY_ENABLE;	//enable the display
	Delay10us(10);						//delay for the data to stabilize
	DISPLAY_CONTROL = DISPLAY_DISABLE;	//disable it again

}


